/ {

        disp_timings: display-timings {
                native-mode = <&pal_cvbs>;
       ntsc_cvbs: timing0 {
                             screen-type = <SCREEN_TVOUT>;
                             out-face = <OUT_P888>;
                             color-mode = <COLOR_YCBCR>;
                             clock-frequency = <27000000>;
                             hactive = <720>;
                             vactive = <576>;
                             hback-porch = <48>;
                             hfront-porch = <33>;
                             vback-porch = <19>;
                             vfront-porch = <2>;
                             hsync-len = <62>;
                             vsync-len = <3>;
                             hsync-active = <1>;
                             vsync-active = <1>;
                             de-active = <0>;
                             pixelclk-active = <0>;
                             swap-rb = <0>;
                             swap-rg = <0>;
                             swap-gb = <0>;
                             interlaced;
                         };
        pal_cvbs: timing1 {
                            screen-type = <SCREEN_TVOUT>;
                            out-face = <OUT_P888>;
                            color-mode = <COLOR_YCBCR>;
                            clock-frequency = <27000000>;
                            hactive = <720>;
                            vactive = <576>;
                            hback-porch = <48>;
                            hfront-porch = <33>;
                            vback-porch = <19>;
                            vfront-porch = <2>;
                            hsync-len = <63>;
                            vsync-len = <3>;
                            hsync-active = <1>;
                            vsync-active = <1>;
                            de-active = <0>;
                            pixelclk-active = <0>;
                            swap-rb = <0>;
                            swap-rg = <0>;
                            swap-gb = <0>;
                            interlaced;
                             };
    };
};
